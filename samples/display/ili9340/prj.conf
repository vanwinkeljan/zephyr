## sample.yaml
```
sample:
    description: TBD
    name: TBD
tests:
-   test:
        build_only: true
        platform_whitelist: nucleo_l476rg
        tags: samples display
```

## prj.conf
```kconfig
CONFIG_PRINTK=y

CONFIG_HEAP_MEM_POOL_SIZE=16384

CONFIG_SPI=y
CONFIG_SPI_LEGACY_API=n
CONFIG_SPI_STM32=y
CONFIG_SPI_1=y
CONFIG_SPI_1_IRQ_PRI=10

CONFIG_DISPLAY=y
CONFIG_ILI9340=y
CONFIG_SYS_LOG_ILI9340_LEVEL=4
CONFIG_ILI9340_SPI_DEV_NAME="SPI_1"
CONFIG_ILI9340_RESET_GPIO_PORT_NAME="GPIOA"
CONFIG_ILI9340_RESET_PIN=9
CONFIG_ILI9340_CMD_DATA_GPIO_PORT_NAME="GPIOA"
CONFIG_ILI9340_CMD_DATA_PIN=8

CONFIG_SYS_LOG=y
CONFIG_SYS_LOG_SHOW_TAGS=y
CONFIG_SYS_LOG_SHOW_COLOR=y
CONFIG_SYS_LOG_DEFAULT_LEVEL=0
CONFIG_SYS_LOG_OVERRIDE_LEVEL=0
```

## src/main.c
```c
/*
 * Copyright (c) 2017 dXplore
 *
 * SPDX-License-Identifier: Apache-2.0
 */

#include <device.h>
#include <display.h>
#include <stdio.h>
#include <string.h>
#include <zephyr.h>

#define SYS_LOG_DOMAIN "main"
#define SYS_LOG_LEVEL SYS_LOG_LEVEL_DEBUG
#include <logging/sys_log.h>

#define SCREEN_WIDTH 320
#define SCREEN_HEIGHT 240

/* This example will update each 500ms one of the LCD corners
 * wit a rectangular bitmap.
 * The color of the bit map is changed for every
 * iteration and is picked out of a set of red, green and blue.
 */
void main(void)
{
	struct device *dev;

	/* size of the rectangle */
	const size_t w = 40;
	const size_t h = 20;
	const size_t buf_size = 3 * w * h;
	u8_t *buf;

	/* xy coordinates where to place rectangles*/
	const size_t x0 = 0;
	const size_t y0 = 0;
	const size_t x1 = SCREEN_WIDTH - w;
	const size_t y1 = 0;
	const size_t x2 = SCREEN_WIDTH - w;
	const size_t y2 = SCREEN_HEIGHT - h;
	const size_t x3 = 0;
	const size_t y3 = SCREEN_HEIGHT - h;

	size_t color = 0;
	size_t cnt = 0;
	int h_step;

	dev = device_get_binding("ILI9340");

	if (dev == NULL) {
		SYS_LOG_ERR("device not found.  Aborting test.");
		return;
	}

	/* Allocate rectangular buffer for corner data */
	buf = k_malloc(buf_size);

	if (buf == NULL) {
		SYS_LOG_ERR("Could not allocate memory.  Aborting test.");
		return;
	}

	/* Clear ili9340 frame buffer before enabling LCD, reuse corner buffer
	 */
	memset(buf, 0, buf_size);
	h_step = (w * h) / SCREEN_HEIGHT;

	for (int idx = 0; idx < SCREEN_HEIGHT; idx += h_step) {
		display_write_bitmap(dev, 0, idx, SCREEN_WIDTH, h_step, buf);
	}

	display_on(dev);

	while (1) {
		/* Update the color of the rectangle buffer and write the buffer
		 * to  one of the corners
		 */
		memset(buf, 0, buf_size);
		for (size_t idx = color; idx < buf_size; idx += 3) {
			*(buf + idx) = 255;
		}
		switch (cnt % 4) {
		case 0:
			display_write_bitmap(dev, x0, y0, w, h, buf);
			break;
		case 1:
			display_write_bitmap(dev, x1, y1, w, h, buf);
			break;
		case 2:
			display_write_bitmap(dev, x2, y2, w, h, buf);
			break;
		case 3:
			display_write_bitmap(dev, x3, y3, w, h, buf);
			break;
		}
		++cnt;
		++color;
		if (color > 2) {
			color = 0;
		}
		k_sleep(500);
	}
}
```

## CMakeLists.txt
```
# Copyright (c) 2019 Jan Van Winkel <jan.van_winkel@dxplore.eu>
#
# SPDX-License-Identifier: Apache-2.0
#

cmake_minimum_required(VERSION 3.13.1)
include($ENV{ZEPHYR_BASE}/cmake/app/boilerplate.cmake NO_POLICY_SCOPE)
project(zlsan)

FILE(GLOB app_sources src/*.c)
target_sources(app PRIVATE ${app_sources})
```

## prj.conf
```kconfig
CONFIG_ZLSAN=y
CONFIG_ZLSAN_EXIT_CODE=0
CONFIG_BACKWARD_CPP=y

CONFIG_HEAP_MEM_POOL_SIZE=1024

CONFIG_ZTEST=y
```

## src/main.c
```c
/*
 * Copyright (c) 2019 Jan Van Winkel <jan.van_winkel@dxplore.eu>
 *
 * SPDX-License-Identifier: Apache-2.0
 */

#include "kernel.h"
#include <ztest.h>

void test_kernel_heap_leak(void)
{
	void *ptr = k_malloc(10);

	zassert_not_null(ptr, NULL);
}

void test_kernel_heap_double_free(void)
{
	void *ptr = k_malloc(10);

	zassert_not_null(ptr, NULL);
	k_free(ptr);
	k_free(ptr);
}

void test_main(void)
{
	ztest_test_suite(kernel_heap_tests,
			 ztest_unit_test(test_kernel_heap_leak),
			 ztest_unit_test(test_kernel_heap_double_free));
	ztest_run_test_suite(kernel_heap_tests);
}
```

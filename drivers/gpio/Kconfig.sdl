## drivers/sensor/tsl2591/Kconfig
```kconfig
# TSL2591 ligth-to-digital converter configuration options

#
# Copyright (c) 2018 dXplore
#
# SPDX-License-Identifier: Apache-2.0
#
menuconfig TSL2591
	bool "TSL2591 sensor"
	depends on I2C
	default	n
	help
	 Enable driver for TSL2591 light-to-digital converter.

if TSL2591

config TSL2591_DEV_NAME
	string "TSL2591 device name"
	default "TSL2591"

config TSL2591_I2C_MASTER_DEV_NAME
	string "I2C master where TSL2591 is connected"
	default "I2C_0"
	help
	 Specify the device name of the I2C master device to which TSL2591 is
	 connected.

endif #TSL2591
```

## dts/bindings/posix/zephyr,posix.yaml
```yaml
#
# Copyright (c) 2019, Jan Van Winkel (jan.van_winkel@dxplore.eu)
#
# SPDX-License-Identifier: Apache-2.0
#
---
title: POSIX Board
version: 0.1

description: >
    This binding gives a base representation of a POSIX board

properties:
    compatible:
      type: string
      category: required
      description: compatible strings
      generation: define
      constraint: "zephyr,posix"
...
```

## lib/gui/Kconfig
```kconfig
#
# Copyright (c) 2018 Jan Van Winkel <jan.van_winkel@dxplore.eu>
#
# SPDX-License-Identifier: Apache-2.0
#

menuconfig LVGL
	bool "LittlevGL GUI library"
	help
	  This option enables the LittlevGL GUI library.

if LVGL

choice LVGL_VERSION
	prompt "LittlevGL GUI library API Version"
	default LVGL_V6
	help
	  LittlevGL GUI library API Version

config LVGL_V5
	bool "API Version 5"

config LVGL_V6
	bool "API Version 6"

endchoice # LVGL_VERSION

rsource "lvgl_common/Kconfig"

endif # LVGL
```

## lib/gui/lvgl_common/Kconfig.fonts
```kconfig
#
# Copyright (c) 2019 Jan Van Winkel <jan.van_winkel@dxplore.eu>
#
# SPDX-License-Identifier: Apache-2.0
#

rsource "../lvgl_v5/Kconfig.fonts"
rsource "../lvgl_v6/Kconfig.fonts"
```

## lib/gui/lvgl_v5/Kconfig
```kconfig
#
# Copyright (c) 2019 Jan Van Winkel <jan.van_winkel@dxplore.eu>
#
# SPDX-License-Identifier: Apache-2.0
#

if LVGL_V5

config LVGL_VDB_STATIC
	bool "Statically allocate virtual display buffer"
	default y
	help
	  Statically allocate virtual display buffer. If disabled pointer should be
	  passed via lv_vdb_set_adr().

if LVGL_DOUBLE_VDB
config LVGL_TRUE_DOUBLE_BUFFERED
	bool "True double buffered"
	help
	  Use true double buffering, VDB size will be set to 100%.
endif

config LVGL_INPUT_MARK_PRESSED_POINTS
	bool "Mark pressed points"
	depends on LVGL_DIRECT_DRAW
	help
	  Mark the pressed points on the screen.

config LVGL_UTF_8
	bool "Enable UTF-8 support"
	default y
	help
	  Enable UTF-8 support


config LVGL_TEXT_BREAK_LONG_WORD_SIZE
	int "Long word size for text break"
	default 12
	help
	  Number of characters in a word before considering a word for a text break

config LVGL_TEXT_BREAK_LONG_WORD_PRE_MIN_LEN
	int "Minimum long word length before text break"
	default 3
	help
	  Minimum number of characters of a long word that should be put before a
	  break

config LVGL_TEXT_BREAK_LONG_WORD_POST_MIN_LEN
	int "Minimum long word length after text break"
	default 1
	help
	  Minimum number of characters of a long word that should be placed after a
	  break

config LVGL_DIRECT_DRAW
	bool "Enable direct draw"
	default y
	help
	  Enable direct draw support.
	  Direct draw bypasses virtual display buffer and directly writes to
	  frame buffer

config LVGL_MULTI_LANGUAGE
	bool "Multi language support"
	help
	  Enable multi language support

if LVGL_MULTI_LANGUAGE
config LVGL_NBR_OF_LANGUAGES
	int "Number of languages"
	default 1
	help
	  Number of languages to support
endif

config LVGL_VLA_SUPPORT
	bool "Enable variable length array support"
	default y
	help
	  Enable variable length array support

config LVGL_COMPILER_NON_CONST_INIT_SUPPORTED
	bool "Enable non constant init"
	default y
	help
	  Indicate if initialization with non constant values is supported

endif # LVGL_V5
```

## lib/gui/lvgl_v6/Kconfig
```kconfig
#
# Copyright (c) 2019 Jan Van Winkel <jan.van_winkel@dxplore.eu>
#
# SPDX-License-Identifier: Apache-2.0
#

if LVGL_V6

choice
	prompt "Rendering Buffer Allocation"
	default LVGL_V6_BUFFER_ALLOC_STATIC
	help
	  Type of allocation that should be used for allocating rendering buffers

	config LVGL_V6_BUFFER_ALLOC_STATIC
		bool "Static"
		help
		  Rendering buffers are statically allocated based on the following
		  configuration parameters:
		  * Horizontal screen resolution
		  * Vertical screen resolution
		  * Rendering buffer size
		  * Bytes per pixel

	config LVGL_V6_BUFFER_ALLOC_DYNAMIC
		bool "Dynamic"
		help
		  Rendering buffers are dynamically allocated based on the actual
		  display parameters

endchoice

choice
	prompt "String character encoding"
	default LVGL_V6_TXT_ENC_ASCII

	config LVGL_V6_TXT_ENC_ASCII
		bool "ASCII string encoding"

	config LVGL_V6_TXT_ENC_UTF8
		bool "UTF-8 string encoding"

endchoice

config LVGL_V6_IMG_CACHE_DEF_SIZE
	int "Default image cache size"
	default 1
	help
	  Default image cache size, image caching keeps the images open.
	  If only the built-in image formats are used there is no real
	  advantage of caching. With complex image decoders (e.g. PNG or JPG)
	  caching can save the continuous decoding of images. However the
	  opened images might consume additional RAM.

endif # LVGL_V6
```

## lib/gui/lvgl_v6/Kconfig.objects
```kconfig
#
# Copyright (c) 2019 Jan Van Winkel <jan.van_winkel@dxplore.eu>
#
# SPDX-License-Identifier: Apache-2.0
#

if LVGL_V6

choice
	prompt "Extend objects clickable area"
	default LVGL_V6_EXT_CLICK_AREA_OFF

	config LVGL_V6_EXT_CLICK_AREA_OFF
		bool "Disabled"

	config LVGL_V6_EXT_CLICK_AREA_TINY
		bool "Only horizontally and vertical"

	config LVGL_V6_EXT_CLICK_AREA_FULL
		bool "Full flexibility"

endchoice

endif # LVGL_V6
```

## modules/Kconfig.backward-cpp
```kconfig
# Kconfig - backward-cpp
#
# Copyright (c) 2019 Jan Van Winkel <jan.van_winkel@dxplore.eu>
#
# SPDX-License-Identifier: Apache-2.0
#

config BACKWARD_CPP
	bool "Enable backward-cpp"
	depends on ARCH_POSIX
	help
	  Enable backward-cpp, backward-ccp is stack trace printer for C++
```

## samples/gui/lvgl/sample.yaml
```yaml
sample:
  description: LVGL sample application
  name: lvgl
tests:
  test:
    build_only: true
    platform_whitelist: nrf52840_pca10056, native_posix, reel_board
    tags: samples display
```

## subsys/debug/zlsan/Kconfig
```kconfig
#
# Copyright (c) 2019 Jan Van Winkel <jan.van_winkel@dxplore.eu>
#
# SPDX-License-Identifier: Apache-2.0
#

config ZLSAN
	bool "Build with Zephyr memory leak sanitizer"
	depends on ARCH_POSIX && ($(ZEPHYR_TOOLCHAIN_VARIANT) = "llvm")
	depends on BACKWARD_CPP
	help
	  Build with Zephyr specific memory leak sanitizer.
	  This is currently only supported by the native_posix port and requires
	  a llvm toolchain.

if ZLSAN

config ZLSAN_EXIT_CODE
	int "ZLSAN exit code"
	default 10
	help
	  Exit code to be used when one or more errors are detected by ZLSAN

endif # ZLSAN
```

## tests/subsys/debug/zlsan/testcase.yaml
```yaml
tests:
  debug.zlsan:
    platform_whitelist: native_posix native_posix_64
    toolchain_whitelist: llvm
```
